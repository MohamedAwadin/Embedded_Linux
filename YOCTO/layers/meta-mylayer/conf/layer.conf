## YOCTO/layers/meta-mylayer/conf/layer.conf
```bitbake
# We have a conf and classes directory, add to BBPATH
BBPATH .= ":${LAYERDIR}"

# We have recipes-* directories, add to BBFILES
BBFILES += "${LAYERDIR}/recipes-*/*/*.bb \
            ${LAYERDIR}/recipes-*/*/*.bbappend"

BBFILE_COLLECTIONS += "meta-mylayer"
BBFILE_PATTERN_meta-mylayer = "^${LAYERDIR}/"
BBFILE_PRIORITY_meta-mylayer = "6"

LAYERDEPENDS_meta-mylayer = "core"
LAYERSERIES_COMPAT_meta-mylayer = "kirkstone"


# TEST ?= "Mohamed"
# TEST ?= "AWADON"
# TEST ?= "aHMED"

# TEST1 ??= "Mohamed"
# TEST1 ??= "AWADON"
# TEST1 ??= "aHMED"
# // aHMED


# TEST1 ??= "Mohamed"
# TEST1 ?= "AWADON"
# TEST1 ??= "aHMED"
# // AWADON

# TEST1 ??= "Mohamed"
# TEST1  = "AWADON"
# TEST1 ??= "aHMED"
# // AWADON

# TEST1 ?= "aHMED"
# TEST1 ??= "Mohamed"
# TEST1  = "AWADON"

# // AWADON


# TEST1 = "aHMED"
# TEST1 = "Mohamed"
# TEST1 = "AWADON"

# AWADON


# TEST1 = "aHMED"
# TEST1:remove = "aHMED"
# TEST1:append = "Mohamed"
# TEST1:append = "Awadin "
# TEST1:append = "Badawi "
# TEST1:append = "Mohamed "
# TEST1:append = "Ahmed "

# TEST2 = "aHMED"
# TEST2:prepend = " Mohamed "

A = "Mohamed"
BA := "${A}"
A = "Awadin"
```
